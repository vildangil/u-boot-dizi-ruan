## configs/dizi_defconfig
```kconfig
CONFIG_ARM=y
CONFIG_ARM64=y
CONFIG_POSITION_INDEPENDENT=y
CONFIG_ARCH_SNAPDRAGON=y
CONFIG_TEXT_BASE=0x80000000
CONFIG_SYS_UBOOT_START=0x80000000
CONFIG_SYS_LOAD_ADDR=0x80000000
CONFIG_SYS_CONFIG_NAME="dizi"
CONFIG_SYS_BOARD="dizi"
CONFIG_SYS_VENDOR="xiaomi"
CONFIG_SYS_SOC="sm7435"
CONFIG_TARGET_DIZI=y
CONFIG_DEFAULT_DEVICE_TREE="qcom/dizi"
CONFIG_OF_UPSTREAM_VENDOR="qcom"
CONFIG_OF_UPSTREAM_BUILD_VENDOR=y
CONFIG_OF_CONTROL=y
CONFIG_OF_LIBFDT=y
CONFIG_OF_LIVE=y
CONFIG_ANDROID_BOOT_IMAGE=y
CONFIG_SKIP_LOWLEVEL_INIT=y
CONFIG_SKIP_LOWLEVEL_INIT_ONLY=y

# База
CONFIG_DM=y
CONFIG_DM_SERIAL=y
CONFIG_MSM_SERIAL=y

# Тактирование
CONFIG_CLK=y
CONFIG_CLK_QCOM=y
CONFIG_CLK_QCOM_RPMH=y

# Пин-контроллер
CONFIG_PINCTRL=y
CONFIG_PINCTRL_QCOM=y
CONFIG_PINCONF=y

# USB и DM_GADGET (КРИТИЧЕСКИ ВАЖНО)
CONFIG_DM_USB_GADGET=y
CONFIG_USB=y
CONFIG_USB_GADGET=y
CONFIG_USB_GADGET_DWC3=y
CONFIG_USB_GADGET_DOWNLOAD=y
CONFIG_USB_DWC3=y
CONFIG_USB_DWC3_GENERIC=y
CONFIG_USB_FUNCTION_FASTBOOT=y
CONFIG_CMD_FASTBOOT=y
CONFIG_PHY=y
CONFIG_PHY_QCOM_QUSB2=y
CONFIG_PHY_QCOM_USB_SNPS_FEMTO_V2=y
CONFIG_DM_REGULATOR=y
CONFIG_DM_REGULATOR_FIXED=y

# Настройки Fastboot
CONFIG_FASTBOOT_BUF_ADDR=0xB0000000
CONFIG_FASTBOOT_BUF_SIZE=0x08000000
CONFIG_FASTBOOT_FLASH=y
CONFIG_USB_GADGET_MANUFACTURER="Xiaomi"
CONFIG_USB_GADGET_PRODUCT_NUM=0x4ee
CONFIG_USB_GADGET_VBUS_DRAW=500

# Отключаем тяжелое
# CONFIG_VIDEO is not set
# CONFIG_UFS is not set
# CONFIG_MMC is not set
# CONFIG_DM_PMIC is not set
# CONFIG_POWER_DOMAIN is not set
# CONFIG_DISPLAY_CPUINFO is not set
# CONFIG_DM_GPIO is not set
# CONFIG_MSM_GPIO is not set
```
